## board/summit/carbon-am62/Kconfig
```kconfig
# SPDX-License-Identifier: GPL-2.0+
#
# Copyright (C) 2024 Ezurio LLC
#

if TARGET_CARBON_AM62_A53

config SYS_BOARD
       default "carbon-am62"

config SYS_VENDOR
       default "summit"

config SYS_CONFIG_NAME
       default "carbon-am62"

endif

if TARGET_CARBON_AM62_R5

config SYS_BOARD
       default "carbon-am62"

config SYS_VENDOR
       default "summit"

config SYS_CONFIG_NAME
       default "carbon-am62"

config SPL_LDSCRIPT
	default "arch/arm/mach-omap2/u-boot-spl.lds"

# source "board/ti/common/Kconfig"

endif
```

## board/summit/carbon-am62l/Kconfig
```kconfig
# SPDX-License-Identifier: GPL-2.0+
#
# Copyright (C) 2026 Ezurio LLC
#

if TARGET_CARBON_AM62L

config SYS_BOARD
       default "carbon-am62l"

config SYS_VENDOR
       default "summit"

config SYS_CONFIG_NAME
       default "carbon-am62l"

endif
```

## board/summit/carbon-am67/Kconfig
```kconfig
# SPDX-License-Identifier: GPL-2.0+
#
# Copyright (C) 2025 Ezurio LLC
#

if TARGET_CARBON_AM67_A53

config SYS_BOARD
       default "carbon-am67"

config SYS_VENDOR
       default "summit"

config SYS_CONFIG_NAME
       default "carbon-am67"

endif

if TARGET_CARBON_AM67_R5

config SYS_BOARD
       default "carbon-am67"

config SYS_VENDOR
       default "summit"

config SYS_CONFIG_NAME
       default "carbon-am67"

config SPL_LDSCRIPT
	default "arch/arm/mach-omap2/u-boot-spl.lds"

endif
```

## board/summit/common/Kconfig
```kconfig
config SUMMIT_BOARD_CONFIG
	bool "Run-time EEPROM based Module Configuration"
	depends on NVMEM

config SPL_SUMMIT_BOARD_CONFIG
	bool "Run-time EEPROM based Module Configuration in SPL"
	depends on SPL_NVMEM
	depends on SUPPORT_SPL

config SPL_SUMMIT_SYS_MENU
	bool "Board configuration SPL Menu"
	select SPL_DISPLAY_PRINT
	depends on SPL_SUMMIT_BOARD_CONFIG
	help
		Enables programming and verification into EEPROM of
		board HW ID and MAC addresses for manufacturing.
		HW ID identifies DRAM type insttalled on the module
		This is required to run prior to initializing DRAM

config CMD_SUMMIT_MAC
	bool "MAC and HW ID commands"
	depends on CMDLINE
	depends on SUMMIT_BOARD_CONFIG
	help
		Enables configuration of MAC and HW ID from the
		command line

config SUMMIT_AUTO_CLOSE
	bool "Advance the secure lifecycle to OEM closed on first boot"
	depends on (ARCH_IMX9 && AHAB_BOOT) || (ARCH_IMX8M && IMX_HAB)
	help
		On a device still in the OEM open lifecycle state, transition to
		OEM closed during board_late_init and reset so the new state takes
		effect.  The AHAB implementation requests the transition through
		the ELE, while the HAB4 implementation programs the secure-boot
		fuse directly.

		Moving to OEM closed is irreversible.

config SUMMIT_AHAB_AUTO_LOCK
	bool "Advance the ELE lifecycle to OEM locked once OEM closed"
	depends on SUMMIT_AUTO_CLOSE
	depends on ARCH_IMX9
	depends on AHAB_BOOT
	help
		Once the device has reached OEM closed, ask the ELE to advance
		to OEM locked and reset.  This is the boot after the one that
		moved the device to OEM closed, not the first boot.

		OEM locked enforces the full set of security policies and is
		irreversible.  Do not enable this until the OEM closed state
		has been validated on the target hardware.
```

## board/summit/ctp_imx8mp/Kconfig
```kconfig
if TARGET_CTP_IMX8MP

config SYS_BOARD
	default "ctp_imx8mp"

config SYS_VENDOR
	default "summit"

config SYS_CONFIG_NAME
	default "ctp_imx8mp"

config IMX_CONFIG
	default "board/summit/ctp_imx8mp/imximage-8mp-lpddr4.cfg"

endif
```

## board/summit/imx8mp_ctp/Kconfig
```kconfig
if TARGET_IMX8MP_CTP

config SYS_BOARD
	default "imx8mp_ctp"

config SYS_VENDOR
	default "summit"

config SYS_CONFIG_NAME
	default "imx8mp_ctp"

config IMX_CONFIG
	default "board/summit/imx8mp_ctp/imximage-8mp-lpddr4.cfg"

endif
```

## board/summit/imx8mp_summitsom/Kconfig
```kconfig
if TARGET_IMX8MP_SUMMITSOM

config SYS_BOARD
	default "imx8mp_summitsom"

config SYS_VENDOR
	default "summit"

config SYS_CONFIG_NAME
	default "imx8mp_summitsom"

config IMX_CONFIG
	default "board/freescale/imx8mp_evk/imximage-8mp-lpddr4.cfg"

config SUMMIT_SOM_DVK
	bool "Summit SOM 8MP DVK support"
	help
	  Enable support for Summit SOM 8MP DVK board.

endif
```

## board/summit/nitrogen_imx8mm/Kconfig
```kconfig
if TARGET_NITROGEN_IMX8MM

config SYS_BOARD
	default "nitrogen_imx8mm"

config SYS_VENDOR
	default "summit"

config SYS_CONFIG_NAME
	default "nitrogen_imx8mm"

config IMX_CONFIG
	default "board/summit/nitrogen_imx8mm/imximage-8mm-lpddr4.cfg"

choice
	prompt "Nitrogen iMX8MM RAM Variant"
	default NITROGEN_IMX8MM_2GB

config NITROGEN_IMX8MM_1GB
	bool "1GB RAM"
	help
	  Enable support for Nitrogen iMX8MM 1GB RAM variant.

config NITROGEN_IMX8MM_2GB
	bool "2GB RAM"
	help
	  Enable support for Nitrogen iMX8MM 2GB RAM variant.

config NITROGEN_IMX8MM_4GB
	bool "4GB RAM"
	help
	  Enable support for Nitrogen iMX8MM 4GB RAM variant.

endchoice

endif
```

## board/summit/nitrogen_imx8mp/Kconfig
```kconfig
if TARGET_NITROGEN_IMX8MP

config SYS_BOARD
	default "nitrogen_imx8mp"

config SYS_VENDOR
	default "summit"

config SYS_CONFIG_NAME
	default "nitrogen_imx8mp"

config IMX_CONFIG
	default "board/summit/nitrogen_imx8mp/imximage-8mp-lpddr4.cfg"

choice
	prompt "Nitrogen iMX8MP RAM Variant"
	default NITROGEN_IMX8MP_2GB_R2

config NITROGEN_IMX8MP_2GB_R2
	bool "2GB RAM R2"
	help
	  Enable support for Nitrogen iMX8MP 2GB RAM variant Rev 2 PCB.

config NITROGEN_IMX8MP_4GB_R2
	bool "4GB RAM R2"
	help
	  Enable support for Nitrogen iMX8MP 4GB RAM variant Rev 2 PCB.

config NITROGEN_IMX8MP_8GB_R2
	bool "8GB RAM R2"
	help
	  Enable support for Nitrogen iMX8MP 8GB RAM variant Rev 2 PCB.

config NITROGEN_IMX8MP_2GB_R1
	bool "2GB RAM R1"
	help
	  Enable support for Nitrogen iMX8MP 2GB RAM variant Rev 1 PCB.

endchoice
endif
```

## board/summit/nitrogen_imx91/Kconfig
```kconfig
if TARGET_NITROGEN_IMX91

config SYS_BOARD
	default "nitrogen_imx91"

config SYS_VENDOR
	default "summit"

config SYS_CONFIG_NAME
	default "nitrogen_imx91"

choice
	prompt "Nitrogen iMX91 Module Variant"
	default NITROGEN_IMX91_SMARC

config NITROGEN_IMX91_SMARC
	bool "SMARC"
	help
	  SMARC and OSM-M Module.

config NITROGEN_IMX91_OSM_S
	bool "OSM-S"
	help
	  OSM-S Module.

endchoice


endif
```

## board/summit/nitrogen_imx93/Kconfig
```kconfig
if TARGET_NITROGEN_IMX93

config SYS_BOARD
	default "nitrogen_imx93"

config SYS_VENDOR
	default "summit"

config SYS_CONFIG_NAME
	default "nitrogen_imx93"

choice
	prompt "Nitrogen iMX93 Module Variant"
	default NITROGEN_IMX93_SMARC

config NITROGEN_IMX93_SMARC
	bool "SMARC"
	help
	  SMARC and OSM-M Module.

config NITROGEN_IMX93_OSM_S
	bool "OSM-S"
	help
	  OSM-S Module.

endchoice

endif
```

## board/summit/nitrogen_imx95/Kconfig
```kconfig
if TARGET_NITROGEN_IMX95

config SYS_BOARD
	default "nitrogen_imx95"

config SYS_VENDOR
	default "summit"

config SYS_CONFIG_NAME
	default "nitrogen_imx95"

endif
```

## board/summit/summitsom_imx8mp/Kconfig
```kconfig
if TARGET_SUMMITSOM_IMX8MP

config SYS_BOARD
	default "summitsom_imx8mp"

config SYS_VENDOR
	default "summit"

config SYS_CONFIG_NAME
	default "summitsom_imx8mp"

config IMX_CONFIG
	default "board/summit/summitsom_imx8mp/imximage-8mp-lpddr4.cfg"

config SUMMIT_SOM_DVK
	bool "Summit SOM 8MP DVK support"
	help
	  Enable support for Summit SOM 8MP DVK board.

endif
```

## board/summit/tungsten_mt83xx/Kconfig
```kconfig
config TARGET_SUMMIT_TUNGSTEN_MT83XX
	bool "Summit Tungsten MT83XX"
	depends on TARGET_MT8188
	select BOARD_INIT
	select BOARD_LATE_INIT
	select BINMAN
	help
	  Select Summit board support for Tungsten MT83XX modules.

if TARGET_SUMMIT_TUNGSTEN_MT83XX

config SUMMIT_TUNGSTEN_MT83XX_UBOOT_RAM_DA
        bool "Build a Summit Tungsten MT83XX RAM U-Boot download-agent image"
        select SPL
        select SPL_BOARD_INIT
        select MTK_BROM_DOWNLOAD_AGENT
        help
          Build a download agent which uses SPL fastboot to receive a FIT into
          RAM ("fastboot stage"), then loads BL31 and U-Boot from it after
          "fastboot continue". The agent does not write to eMMC; U-Boot stops
          at its command prompt.

endif # TARGET_SUMMIT_TUNGSTEN_MT83XX
```

## configs/carbon_am62_a53_defconfig
```kconfig
CONFIG_ARM=y
CONFIG_ARCH_K3=y
CONFIG_SYS_MALLOC_LEN=0x08000000
CONFIG_SYS_MALLOC_F_LEN=0x8000
CONFIG_SPL_GPIO=y
CONFIG_SPL_LIBCOMMON_SUPPORT=y
CONFIG_SPL_LIBGENERIC_SUPPORT=y
CONFIG_SOC_K3_AM625=y
CONFIG_TARGET_CARBON_AM62_A53=y
CONFIG_HAS_CUSTOM_SYS_INIT_SP_ADDR=y
CONFIG_CUSTOM_SYS_INIT_SP_ADDR=0x80b80000
CONFIG_ENV_SIZE=0x2000
CONFIG_ENV_OFFSET=0x380000
CONFIG_DM_GPIO=y
CONFIG_DEFAULT_DEVICE_TREE="k3-am625-carbon-minimal"
CONFIG_OF_LIBFDT_OVERLAY=y
CONFIG_DM_RESET=y
CONFIG_SPL_MMC=y
CONFIG_SPL_SERIAL=y
CONFIG_SPL_DRIVERS_MISC=y
CONFIG_SPL_STACK_R_ADDR=0x82000000
CONFIG_SPL_HAS_BSS_LINKER_SECTION=y
CONFIG_SPL_BSS_START_ADDR=0x80c80000
CONFIG_SPL_BSS_MAX_SIZE=0x80000
CONFIG_SPL_STACK_R=y
CONFIG_SYS_LOAD_ADDR=0x83800000
CONFIG_WATCHDOG_TIMEOUT_MSECS=10000
CONFIG_SPL_SIZE_LIMIT=0x80000
CONFIG_SPL_SIZE_LIMIT_PROVIDE_STACK=0x800
CONFIG_SPL_FS_FAT=y
CONFIG_SPL_LIBDISK_SUPPORT=y
# CONFIG_PSCI_RESET is not set
CONFIG_ARMV8_CRYPTO=y
CONFIG_SUMMIT_BOARD_CONFIG=y
CONFIG_SPL_SUMMIT_BOARD_CONFIG=y
# CONFIG_LOCALVERSION_AUTO is not set
# CONFIG_SYS_MALLOC_CLEAR_ON_INIT is not set
# CONFIG_EFI_LOADER is not set
CONFIG_FIT_SIGNATURE_MAX_SIZE=0x1000000
CONFIG_FIT_RSASSA_PSS=y
# CONFIG_FIT_PRINT is not set
CONFIG_SPL_LOAD_FIT=y
CONFIG_SPL_LOAD_FIT_ADDRESS=0x81000000
# CONFIG_BOOTSTD is not set
CONFIG_BOOTDELAY=-2
CONFIG_BOOTARGS_SUBST=y
CONFIG_BOARD_LATE_INIT=y
CONFIG_SPL_MAX_SIZE=0x80000
CONFIG_SPL_SYS_REPORT_STACK_F_USAGE=y
CONFIG_SPL_BOARD_INIT=y
CONFIG_SPL_SYS_MALLOC_SIMPLE=y
CONFIG_SPL_SYS_MMCSD_RAW_MODE=y
CONFIG_SYS_MMCSD_RAW_MODE_U_BOOT_SECTOR=0x1400
CONFIG_SPL_ENV_SUPPORT=y
CONFIG_SPL_FS_LOAD_PAYLOAD_NAME="u-boot.img"
CONFIG_SPL_I2C=y
CONFIG_SPL_DM_MAILBOX=y
CONFIG_SPL_POWER_DOMAIN=y
CONFIG_SPL_RTC=y
CONFIG_HUSH_PARSER=y
# CONFIG_CMD_BOOTI is not set
# CONFIG_BOOTM_NETBSD is not set
# CONFIG_BOOTM_PLAN9 is not set
# CONFIG_BOOTM_RTEMS is not set
# CONFIG_BOOTM_VXWORKS is not set
# CONFIG_CMD_ELF is not set
# CONFIG_CMD_LOADB is not set
CONFIG_CMD_MMC=y
CONFIG_MMC_SPEED_MODE_SET=y
CONFIG_CMD_PART=y
# CONFIG_CMD_DATE is not set
CONFIG_CMD_FS_GENERIC=y
CONFIG_DOS_PARTITION=y
CONFIG_EFI_PARTITION=y
# CONFIG_SPL_EFI_PARTITION is not set
CONFIG_SPL_PARTITION_UUIDS=y
CONFIG_OF_CONTROL=y
CONFIG_SPL_OF_CONTROL=y
CONFIG_MULTI_DTB_FIT=y
CONFIG_OF_SPL_REMOVE_PROPS="interrupt-parent interrupts gpio-line-names"
CONFIG_ENV_IS_IN_FAT=y
CONFIG_ENV_IS_IN_MMC=y
CONFIG_ENV_FAT_DEVICE_AND_PART=":1"
CONFIG_ENV_MMC_EMMC_HW_PARTITION=1
CONFIG_ENV_WRITEABLE_LIST=y
CONFIG_SPL_ENV_IS_NOWHERE=y
CONFIG_NO_NET=y
CONFIG_SPL_DM=y
CONFIG_SPL_DM_SEQ_ALIAS=y
CONFIG_REGMAP=y
CONFIG_SPL_REGMAP=y
CONFIG_SYSCON=y
CONFIG_SPL_SYSCON=y
CONFIG_SPL_OF_TRANSLATE=y
CONFIG_CLK=y
CONFIG_SPL_CLK=y
CONFIG_CLK_TI_SCI=y
CONFIG_DMA_CHANNELS=y
CONFIG_TI_K3_NAVSS_UDMA=y
CONFIG_TI_SCI_PROTOCOL=y
CONFIG_SPL_DM_GPIO_LOOKUP_LABEL=y
CONFIG_DA8XX_GPIO=y
CONFIG_DM_I2C=y
CONFIG_SYS_I2C_OMAP24XX=y
# CONFIG_INPUT is not set
CONFIG_DM_MAILBOX=y
CONFIG_K3_SEC_PROXY=y
CONFIG_NVMEM=y
CONFIG_SPL_NVMEM=y
CONFIG_FS_LOADER=y
CONFIG_SUPPORT_EMMC_BOOT=y
CONFIG_MMC_IO_VOLTAGE=y
CONFIG_SPL_MMC_IO_VOLTAGE=y
CONFIG_MMC_UHS_SUPPORT=y
CONFIG_SPL_MMC_UHS_SUPPORT=y
CONFIG_MMC_HS200_SUPPORT=y
CONFIG_SPL_MMC_HS200_SUPPORT=y
CONFIG_MMC_SDHCI=y
CONFIG_MMC_SDHCI_ADMA=y
CONFIG_SPL_MMC_SDHCI_ADMA=y
CONFIG_MMC_SDHCI_AM654=y
CONFIG_PHY=y
CONFIG_PINCTRL=y
CONFIG_SPL_PINCTRL=y
CONFIG_PINCTRL_SINGLE=y
CONFIG_POWER_DOMAIN=y
CONFIG_TI_SCI_POWER_DOMAIN=y
CONFIG_DM_REGULATOR=y
CONFIG_SPL_DM_REGULATOR=y
CONFIG_DM_REGULATOR_FIXED=y
CONFIG_SPL_DM_REGULATOR_FIXED=y
CONFIG_DM_REGULATOR_GPIO=y
CONFIG_SPL_DM_REGULATOR_GPIO=y
CONFIG_K3_SYSTEM_CONTROLLER=y
CONFIG_RESET_TI_SCI=y
CONFIG_DM_RTC=y
CONFIG_SPL_DM_RTC=y
CONFIG_RTC_RV3028=y
CONFIG_DEFAULT_ENV_IS_RW=y
CONFIG_DM_SERIAL=y
CONFIG_SOC_DEVICE=y
CONFIG_SOC_DEVICE_TI_K3=y
CONFIG_SOC_TI=y
CONFIG_SYSRESET=y
CONFIG_SPL_SYSRESET=y
CONFIG_SYSRESET_TI_SCI=y
CONFIG_WDT=y
CONFIG_WDT_K3_RTI=y
CONFIG_FS_FAT_MAX_CLUSTSIZE=16384
CONFIG_ZSTD=y
# CONFIG_TOOLS_KWBIMAGE is not set
```
