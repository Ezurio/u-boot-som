// SPDX-License-Identifier: GPL-2.0
/*
 * Common AM625 Carbon dts file for SPLs
 * Copyright (C) 2024 Ezurio LLC
 */

#define SPL_AM625_CARBON_DTB "spl/dts/k3-am625-carbon-minimal.dtb"

#include "k3-am625-carbon-som-u-boot.dtsi"

&sdhci1 {
	bootph-all;
};

&vdd_mmc1 {
	bootph-all;
};

&main_vdd_sdio_a_gpio {
	bootph-all;
};
