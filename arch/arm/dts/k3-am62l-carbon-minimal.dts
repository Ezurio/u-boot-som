// SPDX-License-Identifier: GPL-2.0-or-later OR MIT
/*
 * Copyright 2026 Ezurio LLC
 *
 */

/dts-v1/;

#include "k3-am62l-carbon-som.dtsi"

&reg_mmc1 {
	status = "okay";
};

&sdhci0 { /* SDIO_B eMMC */
	non-removable;
	status = "okay";
};

&sdhci1 { /* SDIO_A uSD */
	status = "okay";
};
