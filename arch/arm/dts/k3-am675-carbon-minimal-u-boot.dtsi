// SPDX-License-Identifier: GPL-2.0
/*
 * Common AM67 Carbon dts file for SPLs
 * Copyright (C) 2025 Ezurio LLC
 */

#define SPL_AM675_CARBON_DTB "spl/dts/k3-am675-carbon-minimal.dtb"

#include "k3-am675-carbon-som-u-boot.dtsi"

#ifdef CONFIG_CPU_V7R
#include "k3-am675-carbon-som-r5.dtsi"
#endif
