// SPDX-License-Identifier: (GPL-2.0+ OR MIT)
/*
 * Copyright 2025 Ezurio
 */

/dts-v1/;

#include "nitrogen-imx95-smarc.dtsi"

/ {
	aliases {
		gpio0 = &gpio1;
		gpio1 = &gpio2;
		gpio2 = &gpio3;
		gpio3 = &gpio4;
		gpio4 = &gpio5;
		i2c0 = &lpi2c1;
		i2c1 = &lpi2c2;
		i2c2 = &lpi2c3;
		i2c3 = &lpi2c4;
		i2c4 = &lpi2c5;
		i2c5 = &lpi2c6;
		i2c6 = &lpi2c7;
		i2c7 = &lpi2c8;
		mmc0 = &usdhc1;
		mmc1 = &usdhc2;
		serial0 = &lpuart1;
	};
};

&usdhc2 { /* SDIO - SDCARD */
	status = "okay";

	// SD card power on the carrier board is not connected to control signal, 
	// as such SD card cannot be reset, thus disabling 1.8V
	no-1-8-v;
};

&usb2 {
	status = "okay";
};
