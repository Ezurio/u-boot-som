// SPDX-License-Identifier: (GPL-2.0+ OR MIT)
/*
 * Copyright 2025 Ezurio
 */

/dts-v1/;

#include "nitrogen-imx91-smarc.dtsi"

&usdhc2 { /* SDIO - SDCARD */
	status = "okay";

	// SD card power on the carrier board is not connected to control signal, 
	// as such SD card cannot be reset, thus disabling 1.8V
	no-1-8-v;
};
