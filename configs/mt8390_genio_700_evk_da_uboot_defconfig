## configs/nitrogen_imx8mp_8g_defconfig
```kconfig
#include <configs/nitrogen_imx8mp_2g_r2_defconfig>

CONFIG_NITROGEN_IMX8MP_8GB=y
```

## configs/nitrogen_imx8mp_defconfig
```kconfig
CONFIG_ARM=y
CONFIG_ARCH_IMX8M=y
CONFIG_TEXT_BASE=0x40200000
CONFIG_SYS_MALLOC_LEN=0x2000000
CONFIG_SPL_GPIO=y
CONFIG_SPL_LIBCOMMON_SUPPORT=y
CONFIG_SPL_LIBGENERIC_SUPPORT=y
CONFIG_ENV_SIZE=0x4000
CONFIG_ENV_OFFSET=0x3F0000
CONFIG_DM_GPIO=y
CONFIG_DEFAULT_DEVICE_TREE="nitrogen-imx8mp-smarc"
CONFIG_TARGET_NITROGEN_IMX8MP=y
CONFIG_NITROGEN_IMX8MP_2GB_R1=y
CONFIG_OF_LIBFDT_OVERLAY=y
CONFIG_SYS_MONITOR_LEN=524288
CONFIG_SPL_SERIAL=y
CONFIG_SPL_DRIVERS_MISC=y
CONFIG_SPL_STACK=0x96dff0
CONFIG_SPL_TEXT_BASE=0x920000
CONFIG_SPL_HAS_BSS_LINKER_SECTION=y
CONFIG_SPL_BSS_START_ADDR=0x96e000
CONFIG_SPL_BSS_MAX_SIZE=0x400
CONFIG_SYS_BOOTM_LEN=0x2000000
CONFIG_SYS_LOAD_ADDR=0x44000000
CONFIG_WATCHDOG_TIMEOUT_MSECS=10000
CONFIG_SPL=y
CONFIG_SPL_IMX_ROMAPI_LOADADDR=0x48000000
# CONFIG_EFI_LOADER is not set
CONFIG_FIT=y
CONFIG_FIT_EXTERNAL_OFFSET=0x3000
CONFIG_FIT_SIGNATURE=y
CONFIG_FIT_RSASSA_PSS=y
# CONFIG_FIT_PRINT is not set
CONFIG_SPL_LOAD_FIT=y
# CONFIG_BOOTSTD is not set
CONFIG_BOOTDELAY=-2
CONFIG_OF_SYSTEM_SETUP=y
CONFIG_BOOTARGS_SUBST=y
CONFIG_SYS_DEVICE_NULLDEV=y
# CONFIG_BOARD_INIT is not set
CONFIG_BOARD_LATE_INIT=y
CONFIG_SPL_MAX_SIZE=0x26000
CONFIG_SPL_BOARD_INIT=y
CONFIG_SPL_BOOTROM_SUPPORT=y
CONFIG_SPL_SYS_MALLOC_SIMPLE=y
# CONFIG_SPL_SHARES_INIT_SP_ADDR is not set
CONFIG_SPL_HAVE_INIT_STACK=y
CONFIG_SPL_SYS_MALLOC=y
CONFIG_SPL_HAS_CUSTOM_MALLOC_START=y
CONFIG_SPL_CUSTOM_SYS_MALLOC_ADDR=0x42200000
CONFIG_SPL_SYS_MALLOC_SIZE=0x80000
CONFIG_SPL_SYS_MMCSD_RAW_MODE=y
CONFIG_SYS_MMCSD_RAW_MODE_U_BOOT_SECTOR=0x300
CONFIG_SPL_I2C=y
CONFIG_SPL_POWER=y
CONFIG_SPL_WATCHDOG=y
CONFIG_HUSH_PARSER=y
# CONFIG_CMD_BOOTI is not set
# CONFIG_BOOTM_NETBSD is not set
# CONFIG_BOOTM_PLAN9 is not set
# CONFIG_BOOTM_RTEMS is not set
# CONFIG_BOOTM_VXWORKS is not set
# CONFIG_CMD_ELF is not set
# CONFIG_CMD_FDT is not set
# CONFIG_CMD_XIMG is not set
# CONFIG_CMD_EXPORTENV is not set
# CONFIG_CMD_IMPORTENV is not set
# CONFIG_CMD_CRC32 is not set
# CONFIG_CMD_LOADB is not set
# CONFIG_CMD_LOADS is not set
CONFIG_CMD_MMC=y
CONFIG_MMC_SPEED_MODE_SET=y
CONFIG_CMD_PART=y
# CONFIG_CMD_PINMUX is not set
# CONFIG_CMD_BLOCK_CACHE is not set
# CONFIG_CMD_HASH is not set
CONFIG_CMD_FS_GENERIC=y
CONFIG_DOS_PARTITION=y
CONFIG_EFI_PARTITION=y
# CONFIG_SPL_EFI_PARTITION is not set
CONFIG_OF_CONTROL=y
CONFIG_SPL_OF_CONTROL=y
CONFIG_ENV_OVERWRITE=y
CONFIG_ENV_IS_NOWHERE=y
CONFIG_ENV_IS_IN_FAT=y
CONFIG_ENV_IS_IN_MMC=y
CONFIG_ENV_FAT_DEVICE_AND_PART=":1"
CONFIG_ENV_MMC_EMMC_HW_PARTITION=1
CONFIG_ENV_WRITEABLE_LIST=y
CONFIG_NO_NET=y
CONFIG_SPL_DM=y
CONFIG_REGMAP=y
CONFIG_SYSCON=y
CONFIG_CLK_COMPOSITE_CCF=y
CONFIG_SPL_CLK_IMX8MP=y
CONFIG_CLK_IMX8MP=y
CONFIG_FSL_CAAM_JR_NTZ_ACCESS=y
CONFIG_GPIO_HOG=y
CONFIG_SPL_GPIO_HOG=y
CONFIG_MXC_GPIO=y
CONFIG_DM_PCA953X=y
CONFIG_DM_I2C=y
CONFIG_FS_LOADER=y
CONFIG_SUPPORT_EMMC_BOOT=y
CONFIG_MMC_IO_VOLTAGE=y
CONFIG_MMC_UHS_SUPPORT=y
CONFIG_MMC_HS400_ES_SUPPORT=y
CONFIG_MMC_HS400_SUPPORT=y
CONFIG_FSL_USDHC=y
CONFIG_PINCTRL=y
CONFIG_SPL_PINCTRL=y
CONFIG_PINCTRL_IMX8M=y
CONFIG_POWER_DOMAIN=y
CONFIG_IMX8M_POWER_DOMAIN=y
CONFIG_DM_PMIC=y
CONFIG_DM_PMIC_PCA9450=y
CONFIG_SPL_DM_PMIC_PCA9450=y
CONFIG_DM_REGULATOR=y
CONFIG_DM_REGULATOR_PCA9450=y
CONFIG_DM_REGULATOR_FIXED=y
CONFIG_DM_REGULATOR_GPIO=y
CONFIG_DM_SERIAL=y
CONFIG_MXC_UART=y
CONFIG_SYSRESET=y
CONFIG_SPL_SYSRESET=y
CONFIG_SYSRESET_PSCI=y
CONFIG_SYSRESET_WATCHDOG=y
CONFIG_IMX_WATCHDOG=y
CONFIG_REGEX=y
# CONFIG_SPL_SHA256 is not set
# CONFIG_SPL_SHA_PROG_HW_ACCEL is not set
CONFIG_SHA_PROG_HW_ACCEL=y
# CONFIG_GZIP is not set
CONFIG_ZSTD=y
# CONFIG_TOOLS_KWBIMAGE is not set
```

## configs/nitrogen_imx91_osm_m_defconfig
```kconfig
#include <configs/nitrogen_imx91_smarc_defconfig>

CONFIG_DEFAULT_DEVICE_TREE="nitrogen-imx91-osm-m"
```

## configs/nitrogen_imx91_osm_s_defconfig
```kconfig
#include <configs/nitrogen_imx91_smarc_defconfig>

CONFIG_DEFAULT_DEVICE_TREE="nitrogen-imx91-osm-s"

CONFIG_NITROGEN_IMX91_SMARC=n
CONFIG_NITROGEN_IMX91_OSM_S=y

CONFIG_DM_PMIC_PF9453=y
CONFIG_SPL_DM_PMIC_PF9453=y
CONFIG_DM_REGULATOR_PF9453=y
CONFIG_SPL_DM_REGULATOR_PF9453=y

CONFIG_DM_PMIC_PCA9450=n
CONFIG_SPL_DM_PMIC_PCA9450=n
CONFIG_DM_REGULATOR_PCA9450=n
CONFIG_SPL_DM_REGULATOR_PCA9450=n
CONFIG_DM_PCA953X=n
```

## configs/nitrogen_imx93_osm_m_defconfig
```kconfig
#include <configs/nitrogen_imx93_smarc_defconfig>

CONFIG_DEFAULT_DEVICE_TREE="nitrogen-imx93-osm-m"
```

## configs/nitrogen_imx93_osm_s_defconfig
```kconfig
#include <configs/nitrogen_imx93_smarc_defconfig>

CONFIG_DEFAULT_DEVICE_TREE="nitrogen-imx93-osm-s"

CONFIG_NITROGEN_IMX93_SMARC=n
CONFIG_NITROGEN_IMX93_OSM_S=y

CONFIG_DM_PMIC_PF9453=y
CONFIG_SPL_DM_PMIC_PF9453=y
CONFIG_DM_REGULATOR_PF9453=y
CONFIG_SPL_DM_REGULATOR_PF9453=y

CONFIG_DM_PMIC_PCA9450=n
CONFIG_SPL_DM_PMIC_PCA9450=n
CONFIG_DM_REGULATOR_PCA9450=n
CONFIG_SPL_DM_REGULATOR_PCA9450=n
CONFIG_DM_PCA953X=n
```

## configs/nitrogen_imx93_smarc_defconfig
```kconfig
CONFIG_ARM=y
CONFIG_ARCH_IMX9=y
CONFIG_TEXT_BASE=0x80200000
CONFIG_SYS_MALLOC_LEN=0x2000000
CONFIG_SYS_MALLOC_F_LEN=0x18000
CONFIG_SPL_GPIO=y
CONFIG_SPL_LIBCOMMON_SUPPORT=y
CONFIG_SPL_LIBGENERIC_SUPPORT=y
CONFIG_NR_DRAM_BANKS=2
CONFIG_ENV_SIZE=0x2000
CONFIG_ENV_OFFSET=0x3F0000
CONFIG_DM_GPIO=y
CONFIG_DEFAULT_DEVICE_TREE="nitrogen-imx93-smarc"
CONFIG_TARGET_NITROGEN_IMX93=y
CONFIG_OF_LIBFDT_OVERLAY=y
CONFIG_SYS_MONITOR_LEN=524288
CONFIG_SPL_SERIAL=y
CONFIG_SPL_DRIVERS_MISC=y
CONFIG_SPL_STACK=0x20519dd0
CONFIG_SPL_TEXT_BASE=0x2049A000
CONFIG_SPL_HAS_BSS_LINKER_SECTION=y
CONFIG_SPL_BSS_START_ADDR=0x2051a000
CONFIG_SPL_BSS_MAX_SIZE=0x2000
CONFIG_SYS_LOAD_ADDR=0x80400000
CONFIG_SPL=y
CONFIG_ARMV8_CRYPTO=y
CONFIG_CMD_DEKBLOB=y
CONFIG_SPL_IMX_ROMAPI_LOADADDR=0x88000000
CONFIG_LTO=y
CONFIG_REMAKE_ELF=y
# CONFIG_EFI_LOADER is not set
CONFIG_FIT=y
CONFIG_FIT_SIGNATURE=y
# CONFIG_FIT_PRINT is not set
# CONFIG_BOOTSTD is not set
CONFIG_BOOTDELAY=-2
CONFIG_OF_SYSTEM_SETUP=y
CONFIG_BOOTARGS_SUBST=y
CONFIG_SYS_CBSIZE=2048
CONFIG_SYS_PBSIZE=2074
# CONFIG_BOARD_INIT is not set
CONFIG_BOARD_LATE_INIT=y
CONFIG_SPL_MAX_SIZE=0x26000
CONFIG_SPL_BOARD_INIT=y
CONFIG_SPL_BOOTROM_SUPPORT=y
# CONFIG_SPL_RAW_IMAGE_SUPPORT is not set
# CONFIG_SPL_LEGACY_IMAGE_FORMAT is not set
CONFIG_SPL_LOAD_IMX_CONTAINER=y
# CONFIG_SPL_SHARES_INIT_SP_ADDR is not set
CONFIG_SPL_HAVE_INIT_STACK=y
CONFIG_SPL_SYS_MALLOC=y
CONFIG_SPL_HAS_CUSTOM_MALLOC_START=y
CONFIG_SPL_CUSTOM_SYS_MALLOC_ADDR=0x83200000
CONFIG_SPL_SYS_MALLOC_SIZE=0x80000
CONFIG_SPL_I2C=y
CONFIG_SPL_POWER=y
CONFIG_SPL_WATCHDOG=y
CONFIG_HUSH_PARSER=y
# CONFIG_CMD_BOOTI is not set
# CONFIG_BOOTM_PLAN9 is not set
# CONFIG_BOOTM_RTEMS is not set
# CONFIG_BOOTM_VXWORKS is not set
# CONFIG_CMD_ELF is not set
# CONFIG_CMD_FDT is not set
# CONFIG_CMD_XIMG is not set
# CONFIG_CMD_EXPORTENV is not set
# CONFIG_CMD_IMPORTENV is not set
# CONFIG_CMD_CRC32 is not set
# CONFIG_CMD_RANDOM is not set
CONFIG_CMD_FUSE=y
# CONFIG_CMD_LOADB is not set
# CONFIG_CMD_LOADS is not set
CONFIG_CMD_MMC=y
CONFIG_MMC_SPEED_MODE_SET=y
CONFIG_CMD_PART=y
# CONFIG_CMD_PINMUX is not set
# CONFIG_CMD_BLOCK_CACHE is not set
CONFIG_CMD_FS_GENERIC=y
CONFIG_DOS_PARTITION=y
CONFIG_EFI_PARTITION=y
# CONFIG_SPL_EFI_PARTITION is not set
CONFIG_OF_CONTROL=y
CONFIG_SPL_OF_CONTROL=y
CONFIG_OF_SPL_REMOVE_PROPS="interrupt-parent interrupts gpio-line-names"
CONFIG_ENV_OVERWRITE=y
CONFIG_ENV_IS_NOWHERE=y
CONFIG_ENV_IS_IN_FAT=y
CONFIG_ENV_IS_IN_MMC=y
CONFIG_ENV_RELOC_GD_ENV_ADDR=y
CONFIG_ENV_FAT_DEVICE_AND_PART=":1"
CONFIG_ENV_MMC_EMMC_HW_PARTITION=1
CONFIG_ENV_WRITEABLE_LIST=y
CONFIG_NO_NET=y
CONFIG_SPL_DM=y
CONFIG_REGMAP=y
CONFIG_SYSCON=y
CONFIG_SPL_CLK_IMX93=y
CONFIG_CLK_IMX93=y
CONFIG_GPIO_HOG=y
CONFIG_SPL_GPIO_HOG=y
CONFIG_IMX_RGPIO2P=y
CONFIG_DM_PCA953X=y
CONFIG_SPL_DM_PCA953X=y
CONFIG_DM_I2C=y
CONFIG_SYS_I2C_IMX_LPI2C=y
CONFIG_FS_LOADER=y
CONFIG_SUPPORT_EMMC_BOOT=y
CONFIG_MMC_IO_VOLTAGE=y
CONFIG_MMC_UHS_SUPPORT=y
CONFIG_MMC_HS400_ES_SUPPORT=y
CONFIG_MMC_HS400_SUPPORT=y
CONFIG_FSL_USDHC=y
CONFIG_PINCTRL=y
CONFIG_SPL_PINCTRL=y
CONFIG_PINCTRL_IMX93=y
CONFIG_POWER_DOMAIN=y
CONFIG_DM_PMIC=y
CONFIG_SPL_DM_PMIC_PCA9450=y
CONFIG_DM_REGULATOR=y
CONFIG_DM_REGULATOR_FIXED=y
CONFIG_DM_REGULATOR_GPIO=y
CONFIG_DM_SERIAL=y
CONFIG_DM_THERMAL=y
CONFIG_FSL_LPUART=y
CONFIG_SYSRESET=y
CONFIG_SYSRESET_PSCI=y
CONFIG_ULP_WATCHDOG=y
CONFIG_WDT=y
CONFIG_REGEX=y
CONFIG_RSASSA_PSS=y
# CONFIG_SPL_SHA1 is not set
# CONFIG_SPL_SHA256 is not set
# CONFIG_CRC16 is not set
# CONFIG_GZIP is not set
CONFIG_ZSTD=y
# CONFIG_TOOLS_KWBIMAGE is not set
```

## configs/nitrogen_imx95_defconfig
```kconfig
CONFIG_ARM=y
CONFIG_ARCH_IMX9=y
CONFIG_TEXT_BASE=0x90200000
CONFIG_SYS_MALLOC_LEN=0x2000000
CONFIG_SYS_MALLOC_F_LEN=0x10000
CONFIG_SPL_GPIO=y
CONFIG_SPL_LIBCOMMON_SUPPORT=y
CONFIG_SPL_LIBGENERIC_SUPPORT=y
CONFIG_NR_DRAM_BANKS=3
CONFIG_ENV_SIZE=0x2000
CONFIG_ENV_OFFSET=0x3F0000
CONFIG_DM_GPIO=y
CONFIG_DEFAULT_DEVICE_TREE="nitrogen-imx95-smarc"
CONFIG_TARGET_NITROGEN_IMX95=y
CONFIG_OF_LIBFDT_OVERLAY=y
CONFIG_SYS_MONITOR_LEN=524288
CONFIG_SPL_MMC=y
CONFIG_SPL_SERIAL=y
CONFIG_SPL_DRIVERS_MISC=y
CONFIG_SPL_TEXT_BASE=0x20480000
CONFIG_SPL_HAS_BSS_LINKER_SECTION=y
CONFIG_SPL_BSS_START_ADDR=0x204d6000
CONFIG_SPL_BSS_MAX_SIZE=0x2000
CONFIG_SYS_LOAD_ADDR=0x90400000
CONFIG_SPL=y
CONFIG_SPL_RECOVER_DATA_SECTION=y
CONFIG_ARMV8_CRYPTO=y
CONFIG_LTO=y
CONFIG_REMAKE_ELF=y
# CONFIG_EFI_LOADER is not set
CONFIG_FIT=y
CONFIG_FIT_SIGNATURE=y
CONFIG_FIT_RSASSA_PSS=y
CONFIG_FIT_VERBOSE=y
# CONFIG_BOOTSTD is not set
CONFIG_BOOTDELAY=-2
CONFIG_OF_SYSTEM_SETUP=y
CONFIG_BOOTARGS_SUBST=y
CONFIG_SYS_CBSIZE=2048
CONFIG_SYS_PBSIZE=2074
CONFIG_BOARD_EARLY_INIT_F=y
# CONFIG_BOARD_INIT is not set
CONFIG_BOARD_LATE_INIT=y
CONFIG_SPL_MAX_SIZE=0x20000
CONFIG_SPL_BOARD_INIT=y
CONFIG_SPL_LOAD_IMX_CONTAINER=y
# CONFIG_SPL_SHARES_INIT_SP_ADDR is not set
CONFIG_SPL_SYS_MALLOC=y
CONFIG_SPL_HAS_CUSTOM_MALLOC_START=y
CONFIG_SPL_CUSTOM_SYS_MALLOC_ADDR=0x93200000
CONFIG_SPL_SYS_MALLOC_SIZE=0x80000
CONFIG_SPL_SYS_MMCSD_RAW_MODE=y
CONFIG_SYS_MMCSD_RAW_MODE_U_BOOT_SECTOR=0x1040
CONFIG_SPL_I2C=y
CONFIG_SPL_DM_MAILBOX=y
CONFIG_SPL_POWER=y
CONFIG_SPL_WATCHDOG=y
CONFIG_HUSH_PARSER=y
# CONFIG_CMD_BOOTI is not set
# CONFIG_BOOTM_NETBSD is not set
# CONFIG_BOOTM_PLAN9 is not set
# CONFIG_BOOTM_RTEMS is not set
# CONFIG_BOOTM_VXWORKS is not set
# CONFIG_CMD_ELF is not set
# CONFIG_CMD_FDT is not set
# CONFIG_CMD_XIMG is not set
# CONFIG_CMD_EXPORTENV is not set
# CONFIG_CMD_IMPORTENV is not set
# CONFIG_CMD_CRC32 is not set
# CONFIG_CMD_RANDOM is not set
CONFIG_CMD_FUSE=y
# CONFIG_CMD_LOADB is not set
# CONFIG_CMD_LOADS is not set
CONFIG_CMD_MMC=y
CONFIG_MMC_SPEED_MODE_SET=y
CONFIG_CMD_PART=y
# CONFIG_CMD_PINMUX is not set
# CONFIG_CMD_BLOCK_CACHE is not set
CONFIG_CMD_FS_GENERIC=y
CONFIG_DOS_PARTITION=y
CONFIG_EFI_PARTITION=y
# CONFIG_SPL_EFI_PARTITION is not set
CONFIG_OF_CONTROL=y
CONFIG_SPL_OF_CONTROL=y
CONFIG_OF_SPL_REMOVE_PROPS="interrupt-parent interrupts gpio-line-names"
CONFIG_ENV_OVERWRITE=y
CONFIG_ENV_IS_IN_FAT=y
CONFIG_ENV_IS_IN_MMC=y
CONFIG_ENV_FAT_DEVICE_AND_PART=":1"
CONFIG_ENV_RELOC_GD_ENV_ADDR=y
CONFIG_ENV_MMC_EMMC_HW_PARTITION=1
CONFIG_ENV_WRITEABLE_LIST=y
CONFIG_NO_NET=y
CONFIG_SPL_DM=y
CONFIG_REGMAP=y
CONFIG_SYSCON=y
CONFIG_SPL_OF_TRANSLATE=y
CONFIG_CLK=y
CONFIG_SPL_CLK=y
CONFIG_SPL_CLK_CCF=y
CONFIG_CLK_CCF=y
CONFIG_CLK_SCMI=y
CONFIG_SPL_CLK_SCMI=y
CONFIG_SPL_FIRMWARE=y
# CONFIG_SCMI_AGENT_SMCCC is not set
CONFIG_GPIO_HOG=y
CONFIG_SPL_GPIO_HOG=y
CONFIG_IMX_RGPIO2P=y
CONFIG_DM_PCA953X=y
CONFIG_SPL_DM_PCA953X=y
CONFIG_DM_I2C=y
CONFIG_SYS_I2C_IMX_LPI2C=y
CONFIG_IMX_MU_MBOX=y
CONFIG_SUPPORT_EMMC_BOOT=y
CONFIG_MMC_IO_VOLTAGE=y
CONFIG_MMC_UHS_SUPPORT=y
CONFIG_MMC_HS400_ES_SUPPORT=y
CONFIG_MMC_HS400_SUPPORT=y
CONFIG_FSL_USDHC=y
CONFIG_PINCTRL=y
CONFIG_SPL_PINCTRL=y
CONFIG_PINCTRL_IMX_SCMI=y
CONFIG_POWER_DOMAIN=y
CONFIG_SCMI_POWER_DOMAIN=y
CONFIG_DM_REGULATOR=y
CONFIG_SPL_DM_REGULATOR=y
CONFIG_DM_REGULATOR_FIXED=y
CONFIG_SPL_DM_REGULATOR_FIXED=y
CONFIG_DM_REGULATOR_GPIO=y
CONFIG_DM_SERIAL=y
CONFIG_FSL_LPUART=y
CONFIG_ULP_WATCHDOG=y
CONFIG_WDT=y
CONFIG_REGEX=y
# CONFIG_SPL_SHA1 is not set
# CONFIG_SPL_SHA256 is not set
# CONFIG_CRC16 is not set
# CONFIG_GZIP is not set
CONFIG_ZSTD=y
# CONFIG_TOOLS_KWBIMAGE is not set
```

## configs/som60sd_mfg_defconfig
```kconfig
#include <configs/som60sd_defconfig>

CONFIG_SPL_SYS_MENU=y
CONFIG_SYS_MEMTEST_START=0x20500000
CONFIG_SYS_MEMTEST_END=0x27500000
CONFIG_LOCALVERSION="-som60sd_mfg"
CONFIG_USE_BOOTARGS=y
CONFIG_BOOTARGS="loglevel=7"
CONFIG_CMD_MEMTEST=y
CONFIG_SYS_ALT_MEMTEST=y
```

## configs/summitsom_imx8mp_defconfig
```kconfig
#include <configs/nitrogen_imx8mp_2g_r2_defconfig>

CONFIG_DEFAULT_DEVICE_TREE="summitsom-imx8mp-min"
CONFIG_TARGET_NITROGEN_IMX8MP=n
CONFIG_TARGET_SUMMITSOM_IMX8MP=y
CONFIG_OF_BOARD_SETUP=y
CONFIG_SUMMIT_SOM_DVK=y
```

## configs/tungsten_mt8370_defconfig
```kconfig
#include <configs/tungsten_mt83xx.config>

CONFIG_DEFAULT_DEVICE_TREE="tungsten-mt8370-smarc"
```

## configs/tungsten_mt8390_defconfig
```kconfig
#include <configs/tungsten_mt8370_defconfig>

CONFIG_DEFAULT_DEVICE_TREE="tungsten-mt8390-smarc"
```

## configs/tungsten_mt8390_ram_da_defconfig
```kconfig
#include <configs/tungsten_mt8370_ram_da_defconfig>

CONFIG_DEFAULT_DEVICE_TREE="tungsten-mt8390-smarc"
```

## configs/wb50n_sysd_defconfig
```kconfig
#include <configs/som60_defconfig>

CONFIG_TARGET_SOM60=n
CONFIG_TARGET_WB50N=y
CONFIG_DEFAULT_DEVICE_TREE="at91-wb50n_sysd"
CONFIG_LOCALVERSION="-wb50n_sysd"
CONFIG_FIT_SIGNATURE_MAX_SIZE=0x800000
CONFIG_MTDPARTS_DEFAULT="mtdparts=atmel_nand:128k(u-boot-spl)ro,1M(u-boot)ro,128k(u-boot-env-a),128k(u-boot-env-b),129152k(ubi)"
```

## configs/wb50nsd_legacy-wbx3_defconfig
```kconfig
#include <configs/som60sd_defconfig>

CONFIG_TARGET_SOM60=n
CONFIG_TARGET_WB50N=y
CONFIG_ENV_SOURCE_FILE="wb50nsd_legacy"
CONFIG_DEFAULT_DEVICE_TREE="at91-wb50nsd"
CONFIG_LOCALVERSION="-wb50nsd_legacy-wbx3"
# CONFIG_AUTOBOOT is not set
CONFIG_CMD_FUSE=y
CONFIG_CMD_DHCP=y
CONFIG_CMD_HASH=y
CONFIG_MTDPARTS_DEFAULT="mtdparts=atmel_nmtdparts=atmel_nand:128k(at91bs)ro,512k(u-boot)ro,128k(u-boot-env-a),128k(u-boot-env-b),5M(kernel-a),5M(kernel-b),48M(rootfs-a),48M(rootfs-b),21376k(user)"
CONFIG_NET_RANDOM_ETHADDR=y
CONFIG_AT91_FUSE=y
CONFIG_SYS_NAND_U_BOOT_LOCATIONS=y
CONFIG_SYS_NAND_U_BOOT_OFFS=0x20000
CONFIG_DM_ETH_PHY=y
CONFIG_MACB=y
# CONFIG_REGEX is not set
```

## configs/wb50nsd_sysd_defconfig
```kconfig
#include <configs/som60sd_defconfig>

CONFIG_TARGET_SOM60=n
CONFIG_TARGET_WB50N=y
CONFIG_DEFAULT_DEVICE_TREE="at91-wb50n_sysd"
CONFIG_LOCALVERSION="-wb50nsd_sysd"
CONFIG_CMD_NAND=n
CONFIG_CMD_MTDPARTS=n
CONFIG_MTD=n
CONFIG_MTD_RAW_NAND=n
CONFIG_SYS_NAND_DRIVER_ECC_LAYOUT=n
CONFIG_NAND_ATMEL=n
CONFIG_ATMEL_NAND_HW_PMECC=n
CONFIG_SYS_NAND_ONFI_DETECTION=n
```
